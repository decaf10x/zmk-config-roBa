## config/west.yml
```yaml
manifest:
  remotes:
    - name: sekigon-gonnoc
      url-base: https://github.com/sekigon-gonnoc
  projects:
    - name: zmk
      remote: sekigon-gonnoc
      revision: v0.4+nemu-link
      import: app/west.yml
    - name: zmk-feature-nemu-link
      remote: sekigon-gonnoc
      revision: zmk-v0.4
      import: config/west.yml
  self:
    path: config
```
